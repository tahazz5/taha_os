OUTPUT_FORMAT(elf64-x86-64)
ENTRY(_start)
PHDRS {
    text PT_LOAD FLAGS(5);
    rodata PT_LOAD FLAGS(4);
    data PT_LOAD FLAGS(6);
}
SECTIONS {
    . = 0x400000;
    .text : { *(.text.start) *(.text .text.*) } :text
    .rodata ALIGN(4096) : { *(.rodata .rodata.*) } :rodata
    .data ALIGN(4096) : { *(.data .data.*) } :data
    .bss ALIGN(4096) : { *(.bss .bss.*) *(COMMON) } :data
    /DISCARD/ : { *(.eh_frame*) *(.note*) *(.comment*) }
}
